## conf/distro/pjrxrpi5-distro.conf
```bitbake
# Distribution definition
DISTRO = "pjrxrpi5-distro"

# Global settings
DISTRO_FEATURES:append = " systemd wifi bluetooth"

# systemd forced
VIRTUAL-RUNTIME_init_manager = "systemd"
VIRTUAL-RUNTIME_initscripts = ""

# NetworkManager forced
NETWORK_MANAGER = "networkmanager"

# Image format
IMAGE_FSTYPES += " wic.bz2"
```
